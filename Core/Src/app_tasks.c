#include "app.h"
#include "ds18b20.h"
#include "sx1276.h"
#include "secure_link.h"
#include "secure_link_keys.h"   /* generated by gen_keys.py, never committed */
#include "main.h"
#include "cmsis_os.h"
#include <stdio.h>
#include <stdint.h>
#include <string.h>

#define SIMULATE_SENSOR_HANG 0   /* set to 1 to test the watchdog */
#define SHOW_SLEEP_STATS     1   /* print how much of the time the CPU sleeps */
#define TX_EVERY_N           4   /* transmit every Nth reading (868.1 MHz allows 1% duty cycle) */

#define HB_LED    0x01U          /* heartbeat bits for the watchdog */
#define HB_SENSOR 0x02U

/* Objects created by CubeMX in main.c */
extern UART_HandleTypeDef huart2;
extern IWDG_HandleTypeDef hiwdg;
extern osMessageQueueId_t tempQueueHandle;
extern osMutexId_t        uartMutexHandle;
extern osSemaphoreId_t    buttonSemHandle;
extern osEventFlagsId_t   wdgFlagsHandle;

/* ---------- Tickless idle statistics ---------- */
static volatile uint32_t g_sleep_entries = 0;   /* times the CPU went to sleep */

/* Called by FreeRTOS just before it sleeps (scheduler suspended: keep it tiny).
   TIM21 drives the HAL tick every 1 ms and would wake the CPU each time,
   so it is paused for the duration of the sleep. */
void PreSleepProcessing(uint32_t *ulExpectedIdleTime)
{
  (void)ulExpectedIdleTime;
  g_sleep_entries++;
  HAL_SuspendTick();
}

/* Called by FreeRTOS right after waking */
void PostSleepProcessing(uint32_t *ulExpectedIdleTime)
{
  (void)ulExpectedIdleTime;
  HAL_ResumeTick();
}

/* Print over UART; the mutex stops two tasks interleaving their output */
static void uart_print(const char *msg)
{
  osMutexAcquire(uartMutexHandle, osWaitForever);
  HAL_UART_Transmit(&huart2, (uint8_t*)msg, strlen(msg), 100);
  osMutexRelease(uartMutexHandle);
}

void app_report_reset_cause(void)
{
  /* Always print, before the RTOS starts, so we can see whether the serial link works */
  const char *b = "\r\n--- BOOT ---\r\n";
  HAL_UART_Transmit(&huart2, (uint8_t*)b, strlen(b), 100);

  if (__HAL_RCC_GET_FLAG(RCC_FLAG_IWDGRST))
  {
    const char *m = "*** Last reset was caused by the WATCHDOG ***\r\n";
    HAL_UART_Transmit(&huart2, (uint8_t*)m, strlen(m), 100);
  }
  __HAL_RCC_CLEAR_RESET_FLAGS();
}

/* Interrupt context: the USER button was pressed */
void HAL_GPIO_EXTI_Callback(uint16_t GPIO_Pin)
{
  static uint32_t last_tick = 0;
  if (GPIO_Pin == USER_BTN_Pin)
  {
    /* FreeRTOS tick, not HAL_GetTick(): the HAL tick pauses during sleep */
    uint32_t now = osKernelGetTickCount();
    if ((now - last_tick) > 200)           /* ignore contact bounce */
    {
      last_tick = now;
      osSemaphoreRelease(buttonSemHandle); /* wakes the sensor task */
    }
  }
}

void app_led_task(void)
{
  for(;;)
  {
    HAL_GPIO_TogglePin(LD2_GPIO_Port, LD2_Pin);
    osEventFlagsSet(wdgFlagsHandle, HB_LED);
    osDelay(250);
  }
}

void app_logger_task(void)
{
  int16_t temp;
  char msg[64];
  static char    plain[16];               /* static: keeps buffers off the task stack */
  static uint8_t pkt[SL_MAX_PACKET];
  static sl_keys keys;                     /* 352 bytes of expanded keys */
  uint32_t reading_count = 0;
  uint32_t fcnt = 0;                       /* frame counter: restarts at 0 on reset (fixed in step 3) */

  sl_init_keys(&keys, SL_ENC_KEY, SL_MIC_KEY);

  /* Radio start-up: a working SPI link and radio read back 0x12 */
  sx1276_power_on_reset();
  uint8_t ver = sx1276_read_reg(SX1276_REG_VERSION);
  snprintf(msg, sizeof(msg), "SX1276 version: 0x%02X (expect 0x%02X)\r\n",
           ver, SX1276_VERSION_OK);
  uart_print(msg);

  int radio_ok = sx1276_lora_init();
  uart_print(radio_ok ? "LoRa init OK: 868.1 MHz, SF7, BW125\r\n"
                      : "LoRa init FAILED\r\n");

  for(;;)
  {
    if (osMessageQueueGet(tempQueueHandle, &temp, NULL, osWaitForever) == osOK)
    {
      if (temp == DS18B20_NOT_FOUND)
      {
        snprintf(msg, sizeof(msg), "Sensor not found - check wiring\r\n");
      }
      else
      {
        int whole = temp / 100;
        int frac  = temp % 100;
        if (frac < 0) frac = -frac;
        snprintf(msg, sizeof(msg), "Temp: %s%d.%02d C\r\n",
                 (temp < 0 && whole == 0) ? "-" : "", whole, frac);
      }
      uart_print(msg);

      /* Send every Nth good reading over LoRa */
      if (radio_ok && temp != DS18B20_NOT_FOUND && (reading_count++ % TX_EVERY_N) == 0)
      {
        int w = temp / 100;
        int f = temp % 100;
        if (f < 0) f = -f;
        int pn = snprintf(plain, sizeof(plain), "T=%s%d.%02d",
                          (temp < 0 && w == 0) ? "-" : "", w, f);

        /* Encrypt, add the MIC and the frame counter */
        int n = sl_seal(&keys, SL_DEV_ID, ++fcnt, (const uint8_t *)plain, (uint8_t)pn,
                        pkt, sizeof(pkt));
        int sent = (n > 0) ? sx1276_send(pkt, (uint8_t)n) : 0;

        snprintf(msg, sizeof(msg), "  TX %s: fcnt=%lu len=%d (%s)\r\n",
                 sent ? "ok" : "FAILED", (unsigned long)fcnt, n, plain);
        uart_print(msg);
      }

#if SHOW_SLEEP_STATS
      {
        snprintf(msg, sizeof(msg), "  sleep entries: %lu, uptime: %lu s\r\n",
                 (unsigned long)g_sleep_entries,
                 (unsigned long)(osKernelGetTickCount() / 1000U));
        uart_print(msg);
      }
#endif
    }
  }
}

void app_sensor_task(void)
{
  /* CubeMX creates the semaphore with count 1: drain it so only real presses count */
  osSemaphoreAcquire(buttonSemHandle, 0);

#if SIMULATE_SENSOR_HANG
  uint8_t cycles = 0;
#endif

  for(;;)
  {
    osEventFlagsSet(wdgFlagsHandle, HB_SENSOR);

    int16_t temp = ds18b20_read_centi();
    osMessageQueuePut(tempQueueHandle, &temp, 0, 0);

    if (osSemaphoreAcquire(buttonSemHandle, 2000) == osOK)
    {
      uart_print("Button pressed - reading now\r\n");
    }

#if SIMULATE_SENSOR_HANG
    if (++cycles >= 5)
    {
      uart_print("Simulating a hung sensor task...\r\n");
      for(;;) { }
    }
#endif
  }
}

void app_watchdog_task(void)
{
  for(;;)
  {
    uint32_t res = osEventFlagsWait(wdgFlagsHandle, HB_LED | HB_SENSOR, osFlagsWaitAll, 4000);
    if ((res & 0x80000000U) == 0)
    {
      HAL_IWDG_Refresh(&hiwdg);            /* all tasks healthy: feed the watchdog */
    }
    else
    {
      uart_print("Watchdog: heartbeat missing - NOT refreshing\r\n");
    }
  }
}
